## CMakeLists.txt
```
cmake_minimum_required(VERSION 3.20.0)

find_package(Zephyr)
project(demo_spi)

target_sources(app PRIVATE src/main.cpp 
	src/BlinkingThread.cpp src/BlinkingThread.h
	)
```

## prj.conf
```kconfig
CONFIG_LOG=y
CONFIG_LOG_BACKEND_UART=y

CONFIG_CPP=y
CONFIG_STD_CPP14=y
CONFIG_CPP_MAIN=y
```

## boards/esp32.overlay
```dts
/ {
    aliases {
        led0 = &led_blue;
    };

    leds {
        compatible = "gpio-leds";
        led_blue: led_0 {
            gpios = <&gpio0 13 GPIO_ACTIVE_LOW>;
        };
    };

};
```

## src/main.cpp
```c
/*
 * Copyright (c) 2016 Intel Corporation
 *
 * SPDX-License-Identifier: Apache-2.0
 */

#include <zephyr/kernel.h>
#include <zephyr/drivers/gpio.h>
#include <zephyr/logging/log.h>

#include "BlinkingThread.h"

LOG_MODULE_REGISTER(main);

/* The devicetree node identifier for the "led0" alias. */
#define LED0_NODE DT_ALIAS(led0)

/*
 * A build error on this line means your board is unsupported.
 * See the sample documentation for information on how to fix this.
 */
static const struct gpio_dt_spec led = GPIO_DT_SPEC_GET(LED0_NODE, gpios);

static BlinkingThread thread;

int main(void)
{
	int ret;

	LOG_INF("Starting demo");

	if (!gpio_is_ready_dt(&led)) {
		return -1;
	}

	ret = gpio_pin_configure_dt(&led, GPIO_OUTPUT_ACTIVE);
	if (ret < 0) {
		return -1;
	}

	thread.setup(&led);
	thread.start();
	thread.wait();

	return 0;
}
```

## src/BlinkingThread.cpp
```c
#include "BlinkingThread.h"

#include <zephyr/kernel.h>
#include <zephyr/drivers/gpio.h>
#include <zephyr/logging/log.h>

LOG_MODULE_REGISTER(BlinkingThread);

/* 1000 msec = 1 sec */
#define SLEEP_TIME_MS   1000

#define STACK_SIZE 500
#define THREAD_PRIORITY 5 

K_THREAD_STACK_DEFINE(threadStack, STACK_SIZE);

BlinkingThread::BlinkingThread()
{
}

void BlinkingThread::setup(const struct gpio_dt_spec *l)
{
	led = l;
}

void BlinkingThread::start()
{
	threadId = k_thread_create(&threadData, 
		threadStack,
		K_THREAD_STACK_SIZEOF(threadStack),
		BlinkingThread::threadTrampoline,
		this, NULL, NULL,
		THREAD_PRIORITY, 0, K_NO_WAIT);
}

void BlinkingThread::wait()
{
	k_thread_join(&threadData, K_FOREVER);
}

void BlinkingThread::threadTrampoline(void *object, void *, void *)
{
	auto threadObject = reinterpret_cast<BlinkingThread*>(object);
	threadObject->main();
}

void BlinkingThread::main()
{
	int ret;

	while (1) {
		LOG_INF("Blinking");
		ret = gpio_pin_toggle_dt(led);
		if (ret < 0) {
			return;
		}
		k_msleep(SLEEP_TIME_MS);
	}

}
```

## src/BlinkingThread.h
```c
#include <zephyr/kernel.h>
#include <zephyr/drivers/gpio.h>

class BlinkingThread {
public:
	explicit BlinkingThread();

	void setup(const struct gpio_dt_spec *led);

	void start();

	void wait();

private:
	const struct gpio_dt_spec *led;

	k_tid_t threadId;
	struct k_thread threadData;

	void main();

	static void threadTrampoline(void *, void *, void *);
};
```
